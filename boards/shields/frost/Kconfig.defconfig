## boards/shields/frost/Kconfig.defconfig
```kconfig
if SHIELD_FROST

# Name must be less than 16 characters long!
config ZMK_KEYBOARD_NAME
    default "Frost"

endif
```

## boards/shields/frost/kconfig.shield
```kconfig
# No whitespace after the comma or in your keyboard name!
config SHIELD_FROST
    def_bool $(shields_list_contains,frost)
```
